// SPDX-License-Identifier: (GPL-2.0+ OR BSD-3-Clause)
/*
 * Copyright (C) MYiR 2024 - All Rights Reserved
 */

/dts-v1/;

#include "myb-stm32mp257x-base.dtsi"
#include "myb-stm32mp257x-rcc.dtsi"
#include "myb-stm32mp257x-1GB-resmem.dtsi"
#include "myb-stm32mp257x-rif.dtsi"
#include "stm32mp25-pinctrl.dtsi"
#include "stm32mp25xxai-pinctrl.dtsi"

/ {
	model = "MYiR MYD-LF25X STM32MP257x Evaluation Board (1GB)";
	compatible = "st,myb-stm32mp257x-1GB", "myir,myb-stm32mp257x-1GB", "myir,myd-lf25x", "st,stm32mp257";

	aliases {
		serial0 = &usart2;
	};

	chosen {
		stdout-path = "serial0:115200n8";
	};

	memory@80000000 {
		device_type = "memory";
		reg = <0x0 0x80000000 0x0 0x40000000>;
	};
};

